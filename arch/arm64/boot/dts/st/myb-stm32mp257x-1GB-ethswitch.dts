// SPDX-License-Identifier: (GPL-2.0-only OR BSD-3-Clause)
/*
 * Copyright (C) MYiR 2024 - All Rights Reserved
 */

/dts-v1/;

#include "myb-stm32mp257x-base.dtsi"
#include "myb-stm32mp257x-resmem-1g.dtsi"
#include "myb-stm32mp257x-ethswitch.dtsi"

#define		ETH_SWITCH_ENABLE  		1
#define		LVDS_7INCH_PANEL		1

/ {
	model = "MYiR STM32MP257x Evaluation Board";
	compatible = "st,stm32mp257f-ev1-ca35tdcid-ostl", "st,stm32mp257f-ev1", "st,stm32mp257";

	chosen {
		stdout-path = "serial0:115200n8";
	};

	memory@80000000 {
		device_type = "memory";
		reg = <0x0 0x80000000 0x0 0x40000000>;
	};

};
